#define VERSION_MACRO
macro_ver: macro_ver {
compatible = "zmk,behavior-macro";
#binding-cells = <0>;
bindings = <&kp N2>, <&kp N0>, <&kp N2>, <&kp N5>, <&kp N0>, <&kp N2>, <&kp N1>, <&kp N0>, <&kp MINUS>, <&kp D>, <&kp V>, <&kp O>, <&kp R>, <&kp MINUS>, <&kp N7>, <&kp N6>, <&kp N6>, <&kp N6>, <&kp E>, <&kp N7>, <&kp E>, <&kp MINUS>, <&kp C>, <&kp L>, <&kp I>, <&kp Q>, <&kp U>, <&kp E>, <&kp RET>;
};
